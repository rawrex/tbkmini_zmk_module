## boards/shields/k1ava/Kconfig.defconfig
```kconfig
if SHIELD_K1AVA_LEFT
    config ZMK_KEYBOARD_NAME
        default "k1ava"
    config ZMK_SPLIT_ROLE_CENTRAL
        default y
endif

if SHIELD_K1AVA_LEFT || SHIELD_K1AVA_RIGHT
    config ZMK_SPLIT
        default y
endif
```

## boards/shields/k1ava/Kconfig.shield
```kconfig
config SHIELD_K1AVA_LEFT
    def_bool $(shields_list_contains,k1ava_left)

config SHIELD_K1AVA_RIGHT
    def_bool $(shields_list_contains,k1ava_right)
```

## boards/shields/tbkmini/Kconfig.defconfig
```kconfig
if SHIELD_TBKMINI_LEFT
    config ZMK_KEYBOARD_NAME
        default "tbkmini"
    config ZMK_SPLIT_ROLE_CENTRAL
        default y
endif

if SHIELD_TBKMINI_LEFT || SHIELD_TBKMINI_RIGHT
    config ZMK_BLE # Needs to be explicit
        default y
    config ZMK_SPLIT
        default y
    config ZMK_SLEEP
        default y
    config ZMK_IDLE_SLEEP_TIMEOUT
        default 300000
    config ZMK_MOUSE
        default y
    config BT_PERIPHERAL_PREF_MIN_INT
        default 24
    config BT_PERIPHERAL_PREF_MAX_INT
        default 48
    config ZMK_IDLE_SLEEP_TIMEOUT
        default 600000
endif
```

## west.yml
```yaml
manifest:
  remotes:
    - name: rawrex
      url-base: https://github.com/rawrex
  projects:
    - name: k1ava
      remote: rawrex
      import: west.yml
```
